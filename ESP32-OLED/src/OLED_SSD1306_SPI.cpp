//////////////////////////////////////////////////////////////////////////
// Author: RSP @ Embedded System Lab (ESL), KMUTNB, Thailand
// File: OLED_SSD1306_SPI.cpp
// Last Modified: 2014-07-13
//////////////////////////////////////////////////////////////////////////

#include "OLED_SSD1306_SPI.h"

using namespace esl;

OLED_SSD1306_SPI::OLED_SSD1306_SPI(
   uint8_t dc, uint8_t cs, uint8_t rst, 
   uint8_t sck, uint8_t mosi )
  : dc_pin(dc), cs_pin(cs), rst_pin(rst), sck_pin(sck), mosi_pin(mosi)
{
   buffer = (uint8_t *)malloc(BUFFER_SIZE);
   use_hw_spi = false;
   pinMode( dc_pin, OUTPUT );
   pinMode( rst_pin, OUTPUT );
   pinMode( cs_pin, OUTPUT );
   pinMode( sck_pin, OUTPUT );
   pinMode( mosi_pin, OUTPUT );
   digitalWrite( cs_pin, HIGH );
}

OLED_SSD1306_SPI::OLED_SSD1306_SPI( uint8_t dc, uint8_t cs, uint8_t rst )
  : dc_pin(dc), cs_pin(cs), rst_pin(rst), sck_pin(0xff), mosi_pin(0xff)
{
   buffer = (uint8_t *)malloc(BUFFER_SIZE);
   use_hw_spi = true;
   pinMode( dc_pin, OUTPUT );
   pinMode( rst_pin, OUTPUT );
   pinMode( cs_pin, OUTPUT );
   digitalWrite( cs_pin, HIGH );
}

OLED_SSD1306_SPI::~OLED_SSD1306_SPI() {
   if (!buffer) {
     free( buffer );
   }
   buffer = NULL;
}

void OLED_SSD1306_SPI::send_cmd( uint8_t cmd ) {
   digitalWrite( dc_pin, LOW );  // command
   digitalWrite( cs_pin, LOW );
   if (use_hw_spi) {
     SPI.transfer( cmd );
   } else {
     shiftOut( mosi_pin, sck_pin, MSBFIRST, cmd );
   }
   digitalWrite( cs_pin, HIGH );
}

void OLED_SSD1306_SPI::init() {
   digitalWrite( rst_pin, LOW );
   delay(50);
   digitalWrite( rst_pin, HIGH );
   delay(100);
   
   send_cmd( 0xAE );   // turn display off, sleep mode
   send_cmd( 0xD5 );   // set display clock ratio and frequency
   send_cmd( 0x80 );   // -> frequency = 0x8, divide ratio = 0x0

   send_cmd( 0xDB );   // set common deselect level (V_COMH)
   send_cmd( 0x10 );   // -> 0x10 = 0.77 x VCC (default)

   send_cmd( 0xD9 );   // set precharge period
   send_cmd( 0xF1 );   // -> phase2 = 0xF, phase1 = 0x1

   send_cmd( 0x8D );   // set charge pump
   send_cmd( 0x14 );   // -> 0x14 (enable charge pump)

   send_cmd( 0xA8 );   // set multiplex ratio
   send_cmd( 0x3F );   // -> 1/64 duty

   send_cmd( 0xD3 );   // set display offset (vertical shift)
   send_cmd( 0x00 );   // -> offset = 0x00 (default)

   send_cmd( 0x81 );   // set contrast
   send_cmd( 0xFF );   // -> 0xff (max. value)

   send_cmd( 0x40 );   // set display start line -> line 0
   send_cmd( 0xA1 );   // set segment re-map: column address 127 is mapped to SEG0
   send_cmd( 0xC8 );   // set common-output scan direction: Scan from COM63 to COM0
   send_cmd( 0xDA );   // set common pins shardware configuration
   send_cmd( 0x02 | (0b01 << 4) ); // use alternative COM pin configuration,
                                         // disable COM Left/Right remap
   send_cmd( 0x20 );   // set memory addressing mode
   send_cmd( 0x00 );   // -> 0x00 (horizontal addressing mode)

   send_cmd( 0x21 );   // set column address (0..127 columns for 128x64 display)
   send_cmd( 0 );      // set column start address
   send_cmd( 127 );    // set column end address

   send_cmd( 0x22 );   // set page address (0..7 pages for 128x64 display)
   send_cmd( 0 );      // set page start address
   send_cmd( 7 );      // set page end address

   send_cmd( 0xA4 );   // resume to RAM content display (default)
   send_cmd( 0xA6 );   // normal display (default)

   send_cmd( 0xAF );   // turn display on, normal mode
   clearDisplay();
}

void OLED_SSD1306_SPI::update() {
   digitalWrite( dc_pin, HIGH );  // data
   digitalWrite( cs_pin, LOW );
   for ( uint16_t i=0; i < BUFFER_SIZE; i++ ) {
     if (use_hw_spi) {
       SPI.transfer( buffer[i] );
     } else {
       shiftOut( mosi_pin, sck_pin, MSBFIRST, buffer[i] );
     }
   }
   digitalWrite( cs_pin, HIGH );
}

void OLED_SSD1306_SPI::clearBuffer() {
  memset( buffer, 0x00, BUFFER_SIZE );
}

void OLED_SSD1306_SPI::clearDisplay() {
  clearBuffer();
  update();
}

void OLED_SSD1306_SPI::displayOnOff( boolean onOff ) {
  send_cmd( onOff ? 0xAF : 0xAE );
}

void OLED_SSD1306_SPI::inverseDisplay( boolean inverse ) {
  send_cmd( inverse ? 0xA7 : 0xA6 );
}

void OLED_SSD1306_SPI::writeByteToBuffer( uint8_t x, uint8_t y, uint8_t data ) {
  if (x >= LCD_WIDTH || y >= LCD_HEIGHT)
     return;
  buffer[x + ((uint16_t)y/8) * LCD_WIDTH] = data;
}

void OLED_SSD1306_SPI::drawText( uint8_t x, uint8_t y, const char *text ) {
  uint16_t pos, p = x + ((uint16_t)y/8) * LCD_WIDTH;
  uint8_t vshift = (y%8);
  uint8_t data;
  for ( uint8_t i=0; i < strlen(text); i++ ) {
    pos = font_width*(text[i]-0x20);
    for ( uint8_t j=0; j < font_width; j++ ) {
       data = pgm_read_byte_near( font + pos );
       pos++;
       if ( vshift > 0 ) {
         buffer[ p ] |= (data << vshift);
         buffer[ p + LCD_WIDTH ] |= (data >> (8-vshift));
       } else {
         buffer[ p ] |= data;
       }
       p++;
    }
    p += 1;
  }
}

void OLED_SSD1306_SPI::drawPixel( uint8_t x, uint8_t y, boolean onOff ) {
  if (x >= LCD_WIDTH || y >= LCD_HEIGHT)
     return;
  if ( onOff ) { // set pixel
     buffer[x + ((uint16_t)y/8) * LCD_WIDTH] |= 1 << (y%8);
  } else { // clear pixel
     buffer[x + ((uint16_t)y/8) * LCD_WIDTH] &= ~(1 << (y%8));
  }
}

void OLED_SSD1306_SPI::drawRect( uint8_t x0, uint8_t y0, uint8_t x1, uint8_t y1 ) {
  x1 = min( x1, LCD_WIDTH-1 );
  y1 = min( y1, LCD_HEIGHT-1 );
  for ( uint8_t i=x0; i <= x1; i++ ) {
     drawPixel( i, y0, true );
     drawPixel( i, y1, true );
  }
  for ( uint8_t j=y0; j <= y1; j++ ) {
     drawPixel( x0, j, true );
     drawPixel( x1, j, true );
  }
}

// normal font
static prog_uchar NORMAL_FONT[] PROGMEM = { // 96 x 5 bytes
	0x00, 0x00, 0x00, 0x00, 0x00, // space
	0x00, 0x00, 0x5F, 0x00, 0x00, // !
	0x00, 0x07, 0x00, 0x07, 0x00, // "
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	0x00, 0x06, 0x09, 0x09, 0x06, // degree
};

// Bold font
static prog_uchar BOLD_FONT[] PROGMEM = { // 96 x 8 bytes
    0x00, 0x00, 0x00, 0x00, 0x00, 0x00, 0x00, 0x00,   // ' '
    0x00, 0x00, 0x00, 0xDF, 0xDF, 0x00, 0x00, 0x00,   // '!'
    0x00, 0x03, 0x07, 0x00, 0x03, 0x07, 0x00, 0x00,   // '"'
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    0x00, 0x06, 0x06, 0x09, 0x09, 0x09, 0x06, 0x06,   // degree
};

void OLED_SSD1306_SPI::useBoldFont() {
  font_width = 8;
  font = BOLD_FONT;
}

void OLED_SSD1306_SPI::useNormalFont() {
  font_width = 5;
  font = NORMAL_FONT;
}

//////////////////////////////////////////////////////////////////////////

